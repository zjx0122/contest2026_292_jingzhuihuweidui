## app/desk_health/Kconfig
```kconfig
config EXAMPLES_DESK_HEALTH
	tristate "Desktop Health Monitor Example"
	default n
	---help---
		Enable the Desktop Health Monitor application for OpenVela.

if EXAMPLES_DESK_HEALTH

config EXAMPLES_DESK_HEALTH_PROGNAME
	string "Program name"
	default "desk_health"

config EXAMPLES_DESK_HEALTH_PRIORITY
	int "Desk Health task priority"
	default 100

config EXAMPLES_DESK_HEALTH_STACKSIZE
	int "Desk Health stack size"
	default 2048

config DESK_HEALTH_ESP32
	bool "ESP32-S3 通信任务"
	default n
	depends on ESP32S3_UART
	---help---
		启用 ESP32-S3 通信任务。
		功能：发送传感器数据到 ESP32-S3，接收控制命令。

endif
```

## app/smart_home/Kconfig
```kconfig
# app/smart_home/Kconfig
# 智能家居应用配置

config PACKAGES_DEMOS_SMART_HOME
	bool "Smart Home Application"
	default n
	depends on ARCH_CHIP_STM32F407VG
	---help---
		Enable the smart home application for STM32F407VGT6.
		Includes GC9A01 display, SHT30, VL53L0X, LD2410B radar,
		SU-03T voice, BLE communication.

if PACKAGES_DEMOS_SMART_HOME

config PACKAGES_DEMOS_SMART_HOME_PROGNAME
	string "Program name"
	default "smart_home"
	---help---
		Command name shown in NuttShell (NSH).

config PACKAGES_DEMOS_SMART_HOME_PRIORITY
	int "Task priority"
	default 100

config PACKAGES_DEMOS_SMART_HOME_STACKSIZE
	int "Task stack size"
	default 4096

endif # PACKAGES_DEMOS_SMART_HOME
```

## board/stm32f407-custom/configs/nsh/defconfig
```kconfig
# STM32F407VGT6 完整BSP配置
# 硬件：GC9A01屏/SHT30+VL53L0X/LD2410B/SU-03T/BLE/W25Q/SD卡

# === 架构配置 ===
CONFIG_ARCH="arm"
CONFIG_ARCH_BOARD="stm32f407-custom"
CONFIG_ARCH_BUTTONS=y
CONFIG_ARCH_CHIP="stm32"
CONFIG_ARCH_CHIP_STM32=y
CONFIG_ARCH_CHIP_STM32F407VG=y
CONFIG_ARCH_FPU=y
CONFIG_ARCH_STACKDUMP=y
CONFIG_BOARD_LATE_INITIALIZE=y
CONFIG_BOARD_LOOPSPERMSEC=16717

# === SWD调试模式（禁用JTAG，释放PB3/PB4/PA15为GPIO）===
CONFIG_STM32_JTAG_SW_ENABLE=y

# === 电源管理 ===
CONFIG_STM32_PWR=y

# === 内存配置 ===
CONFIG_RAM_SIZE=131072
CONFIG_RAM_START=0x20000000
CONFIG_MM_REGIONS=2

# === 调度器 ===
CONFIG_RR_INTERVAL=200
CONFIG_SCHED_WAITPID=y
CONFIG_SCHED_WORKQUEUE=y
CONFIG_PREALLOC_TIMERS=4

# === 串口配置 ===
# USART1: 调试串口（PA9=TX, PA10=RX）
CONFIG_STM32_USART1=y
CONFIG_USART1_SERIAL_CONSOLE=y
CONFIG_USART1_RXBUFSIZE=256
CONFIG_USART1_TXBUFSIZE=256

# USART2: LD2410B毫米波雷达（PA2=TX, PA3=RX）
CONFIG_STM32_USART2=y
CONFIG_USART2_RXBUFSIZE=512
CONFIG_USART2_TXBUFSIZE=256

# USART3: SU-03T离线语音模块（PB10=TX, PB11=RX）
CONFIG_STM32_USART3=y
CONFIG_USART3_RXBUFSIZE=256
CONFIG_USART3_TXBUFSIZE=256

# UART4: BLE蓝牙模块（PC10=TX, PC11=RX, AF8）
CONFIG_STM32_UART4=y
CONFIG_UART4_RXBUFSIZE=512
CONFIG_UART4_TXBUFSIZE=256

# === I2C配置 ===
# I2C1: SHT30温湿度 + VL53L0X测距（PB6=SCL, PB7=SDA, AF4）
CONFIG_STM32_I2C1=y

# === SPI配置 ===
# SPI1: GC9A01显示屏（PA5=SCK, PA6=MISO, PA7=MOSI）
CONFIG_STM32_SPI1=y
# SPI2: W25QXX Flash（PB13=SCK, PB14=MISO, PB15=MOSI, PB12=CS）
CONFIG_STM32_SPI2=y

# === SDIO配置 ===
# SD卡: 1-bit SDIO模式（PC8=D0, PC12=CLK, PD2=CMD）
CONFIG_STM32_SDIO=y
CONFIG_SDIO_DMA=y
CONFIG_MMCSD=y
CONFIG_MMCSD_SDIO=y
CONFIG_MMCSD_SDIO_WIDTH_1BIT=y

# === 文件系统 ===
CONFIG_FS_PROCFS=y
CONFIG_FS_FAT=y
CONFIG_FAT_MAXFNAME=32
CONFIG_BUILTIN=y
CONFIG_NSH_BUILTIN_APPS=y
CONFIG_NSH_READLINE=y
CONFIG_LINE_MAX=64
CONFIG_NSH_FILEIOSIZE=512
# CONFIG_NSH_ARGCAT is not set
# CONFIG_NSH_CMDOPT_HEXDUMP is not set

# === I2C用户态驱动 ===
CONFIG_I2C_DRIVER=y

# === C++支持 ===
CONFIG_HAVE_CXX=y
CONFIG_HAVE_CXXINITIALIZE=y

# === NSH启动 ===
CONFIG_SYSTEM_NSH=y
CONFIG_INIT_ENTRYPOINT="nsh_main"

# === 输出格式 ===
CONFIG_INTELHEX_BINARY=y
CONFIG_RAW_BINARY=y

# === 竞赛应用 ===
CONFIG_EXAMPLES_LIGHT_CONTROL=y

# === SDIO 依赖 ===
CONFIG_SCHED_HPWORK=y
CONFIG_MMCSD=y
CONFIG_MMCSD_SPI=n
CONFIG_FS_FAT=y
```
